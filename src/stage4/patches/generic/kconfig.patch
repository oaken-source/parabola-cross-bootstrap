## src/stage4/patches/generic/kconfig.patch
```kconfig
diff -rupN a/PKGBUILD b/PKGBUILD
--- a/PKGBUILD	2018-06-09 13:08:03.711918597 +0200
+++ b/PKGBUILD	2018-06-09 14:49:11.028645804 +0200
@@ -11,7 +11,7 @@ arch=(x86_64)
 url='https://community.kde.org/Frameworks'
 license=(LGPL)
 depends=(qt5-base)
-makedepends=(extra-cmake-modules qt5-tools clang python-pyqt5 python2-pyqt5 doxygen)
+makedepends=(extra-cmake-modules qt5-tools python-pyqt5 python2-pyqt5 doxygen)
 optdepends=('python-pykf5: to use the Python 3 bindings' 'python2-pykf5: to use the Python 2 bindings')
 groups=(kf5)
 source=("https://download.kde.org/stable/frameworks/${pkgver%.*}/$pkgname-$pkgver.tar.xz"{,.sig})
```
